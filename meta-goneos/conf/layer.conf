## meta-goneos/conf/layer.conf
```bitbake
# Layer configuration for meta-goneos

# Minimal compatibility with Yocto versions
LAYERSERIES_COMPAT ?= "kirkstone dunfell hardknott honister"

# Pfad zu Rezepten angeben
BBPATH .= ":${LAYERDIR}"

# Pfad für Rezepte
BBFILES += "${LAYERDIR}/recipes-*/*/*.bb ${LAYERDIR}/recipes-*/*/*.bbappend"

BBFILE_COLLECTIONS += "meta-goneos"
BBFILE_PATTERN_meta-goneos := "^${LAYERDIR}/"
BBFILE_PRIORITY_meta-goneos = "6"
```
